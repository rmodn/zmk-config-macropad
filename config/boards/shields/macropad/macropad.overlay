/{
    chosen{
        zmk,kscan = &default_kscan;
    };

    default_kscan: kscan{
        compatible = "zmk,kscan-gpio-direct";

        input-gpios = 
            <&gpio0 26 (GPIO_ACTIVE_LOW | GPIO_PULL_UP)>,
            <&gpio0 27 (GPIO_ACTIVE_LOW | GPIO_PULL_UP)>,
            <&gpio0 28 (GPIO_ACTIVE_LOW | GPIO_PULL_UP)>,
            <&gpio0 29 (GPIO_ACTIVE_LOW | GPIO_PULL_UP)>,
            <&gpio0 24 (GPIO_ACTIVE_LOW | GPIO_PULL_UP)>,
            <&gpio0 25 (GPIO_ACTIVE_LOW | GPIO_PULL_UP)>,
            <&gpio0 18 (GPIO_ACTIVE_LOW | GPIO_PULL_UP)>,
            <&gpio0 19 (GPIO_ACTIVE_LOW | GPIO_PULL_UP)>,
            <&gpio0 20 (GPIO_ACTIVE_LOW | GPIO_PULL_UP)>;
    };
};